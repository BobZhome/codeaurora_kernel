## arch/arm/mach-msm/lge/Kconfig
```kconfig
config MACH_LGE
	bool

menu "LGE Board Selection"
source "arch/arm/mach-msm/lge/Kconfig.board"
endmenu

menu "LGE Specific Patches"

config LGE_HANDLE_PANIC
    tristate "Support LGE Kernel Panic Handler"
    default n
    depends on MACH_LGE
    help
    LGE Error handler.

config LGE_HIDDEN_RESET
	tristate "LGE hidden reset"
	default n
	depends on MACH_LGE && LGE_HANDLE_PANIC
	help
	  Enables support for LGE hidden reset. For turn on this feature,
	  "echo 1 > /sys/module/lge_handle_panic/parameters/hreset_enable"
	  or "lge_handle_panic.hreset_enable=1" from cmdline.

config LGE_QFPROM_INTERFACE
    bool "Support qfprom interface"
    default n
    depends on MACH_LGE
    help
    LGE QFPROM DRIVER.
config LGE_LCD_TUNING
     bool "lcd_tuning"
	 default n
	 depends on MACH_LGE
	 help
		Support LCD tuning.

config LGE_QC_LCDC_LUT
     bool "Set initial Qualcomm LCDC lut"
         default n
         depends on MACH_LGE
         help
                Set initail Qualcomm LCDC Look Up Table.

config LGE_KCAL
     bool "Interface to calibrate LCD color temperature"
         default n
         depends on MACH_LGE
         help
                Interface to calibrate LCD color temperature

config LGE_KCAL_QLUT
     bool "Interface to calibrate LCD color temperature by QLUT"
         default n
         depends on MACH_LGE && LGE_QC_LCDC_LUT && LGE_KCAL
         help
                Interface to calibrate LCD color temperature by QLUT

config LGE_USES_SMD_DS_TTY
	bool "Explicitly use smd tty driver for DS"
	default n
	depends on MSM_SMD_TTY && MACH_LGE
	help
		In Qualcomm MSM8960, smd tty driver for ds(/dev/smd0) is not used.
		Say yes if this tty driver must be used on LGE device. This is used
		to connect smd channel in user space(for example, ATCMD processing).

config LGE_SUSPEND_TIME
    tristate "Log time spent in suspend"
    default y
    depends on MACH_LGE
	help
	  Prints the time spent in suspend in the kernel log, and
	  keeps statistics on the time spent in suspend in
	  /sys/kernel/debug/suspend_time

	  This patch serves same function with google's suspend_time.c

config LGE_EARLYSUSPEND_FUNC_TIME
    tristate "Log time spent in each earlysuspend call"
    default y
    depends on MACH_LGE
	help
	  Keeps the time statistics spent in each earlysuspend in 
	  /sys/kernel/debug/earlysuspend_func_time.
	  This file shows the average and max tiem of each 
	  earlysuspend/lateresume function.

config LGE_SUSPEND_AUTOTEST
    tristate "Test suspend/resume and earlysuspend/lateresume automatically"
    default y
    depends on MACH_LGE && SUSPEND && EARLYSUSPEND
	help
      This option will let you suspend your machine, and make it wake up
	  a few seconds later using an timer automatically.  
	  Enable this with a kernel parameter by sysfs.

config LGE_LOG_SERVICE
	bool "Support LGE log service"
	default y
	depends on MACH_LGE
	help
	  Support LGE log service. The author of this patch is cs77.ha@lge.com

#BEGIN: 0019632 chanha.park@lge.com 2012-05-31
#ADD: 0019632: [F200][BT] Bluetooth board bring-up	  
config LGE_BLUESLEEP
	default y
	bool "MSM8960 LGE Bluetooth LPM"
	depends on MACH_LGE
#END: 0019632 chanha.park@lge.com 2012-05-31	
	
config LGE_LASTLBA_BACKUPGPT
	bool "Force to find Backup GPT at LAST LBA"
	depends on EFI_PARTITION
	help
	  Say Y here if you would like to make kernel always find Backup GPT
	  at Last LBA.
config LGE_ETB_SUSPEND
    tristate "Disable ETB during suspend state"
    default y
    depends on MACH_LGE
	depends on MSM_QDSS
	help
	  Disable ETB during suspend state for entering XO shutdown,

config LGE_BITE_RESET
	tristate "Disable PS_HOLD reset"
	default n
	depends on MACH_LGE
	help
	  Reset device by WDT BITE instead of PS_HOLD
endmenu
```

## arch/arm/mach-msm/lge/Kconfig.board
```kconfig
#
# Inlcude the specific Kconfig file for LGE board
#

# D1L
source "arch/arm/mach-msm/lge/d1l/Kconfig"

# D1L_KR
source "arch/arm/mach-msm/lge/d1l_kr/Kconfig"

# L_DCM
source "arch/arm/mach-msm/lge/l_dcm/Kconfig"

# LX(L0/L2/L1)
source "arch/arm/mach-msm/lge/lx/Kconfig"

# LX_KR(L1u/L1sk/L1kt)
source "arch/arm/mach-msm/lge/lx_kr/Kconfig"

# L1(L1m/L1v)
source "arch/arm/mach-msm/lge/l1/Kconfig"
```

## arch/arm/mach-msm/lge/d1l/Kconfig
```kconfig
config BOARD_HEADER_FILE
	string "LGE board specific header file name"
	default ""

config MACH_MSM8960_D1L
	depends on ARCH_MSM8960
	select MACH_LGE
	bool "MSM8960 D1L"
	help
	  Support for the LGE MSM8960 D1L device.

choice
	depends on MACH_MSM8960_D1L
	prompt "D1L Board Selection"
	default MACH_MSM8960_D1LA

config MACH_MSM8960_D1LA
	bool "MSM8960 D1L AT&T"
	help
	  Support for the LGE MSM8960 D1L AT&T device.

config MACH_MSM8960_D1LV
	bool "MSM8960 D1L Verizon"
	help
	  Support for the LGE MSM8960 D1L Verizon device.

config MACH_MSM8960_LGPS3
	bool "MSM8960 LGPS3 (Based on D1L AT&T)"
	help
	  Support for the LGE MSM8960 HDK device.
endchoice
```

## arch/arm/mach-msm/lge/lx_kr/Kconfig
```kconfig
config BOARD_HEADER_FILE
	string "LGE board specific header file name"
	default ""

config MACH_MSM8960_LX_KR
	depends on ARCH_MSM8960
	select MACH_LGE
	bool "MSM8960 LX_KR"
	help
	  Support for the LGE MSM8960 LX device.

choice
	depends on MACH_MSM8960_LX_KR
	prompt "LX Board Selection"
	default MACH_MSM8960_L1u

config MACH_MSM8960_L1sk
	bool "MSM8960 L1 SKT"
	help
	  Support for the LGE MSM8960 L1 SKT device.

config MACH_MSM8960_L1kt
	bool "MSM8960 L1 KT"
	help
	  Support for the LGE MSM8960 L1 KT device.

config MACH_MSM8960_L1u
	bool "MSM8960 L1 LGU+"
	help
	  Support for the LGE MSM8960 L1 LGU+ device.

endchoice
```

## arm/mach-msm/lge/Kconfig.board
```kconfig
#
# Inlcude the specific Kconfig file for LGE board
#

# D1L
source "arch/arm/mach-msm/lge/d1l/Kconfig"

# D1L_KR
source "arch/arm/mach-msm/lge/d1l_kr/Kconfig"

# L_DCM
source "arch/arm/mach-msm/lge/l_dcm/Kconfig"

# LX(L0/L2/L1)
source "arch/arm/mach-msm/lge/lx/Kconfig"
```

## drivers/char/diag/Kconfig
```kconfig
menu "Diag Support"

config DIAG_CHAR
	tristate "char driver interface and diag forwarding to/from modem"
	default m
	depends on USB_G_ANDROID || USB_FUNCTION_DIAG || USB_QCOM_MAEMO
	depends on ARCH_MSM
	help
	 Char driver interface for diag user space and diag-forwarding to modem ARM and back.
	 This enables diagchar for maemo usb gadget or android usb gadget based on config selected.
endmenu

menu "DIAG traffic over USB"

config DIAG_OVER_USB
	bool "Enable DIAG traffic to go over USB"
        depends on ARCH_MSM
	default y
	help
	 This feature helps segregate code required for DIAG traffic to go over USB.
endmenu

menu "SLATE Support"

config LGE_SLATE
	bool "Enable SLATE Key Logging message routing"
		depends on DIAG_OVER_USB
	default y
	help
	 This feature helps decide whether slate key logging start message would be routed to apps or not.
endmenu

menu "SDIO support for DIAG"

config DIAG_SDIO_PIPE
	depends on MSM_SDIO_AL
	default y
	bool "Enable 9K DIAG traffic over SDIO"
	help
	 SDIO Transport Layer for DIAG Router
endmenu

menu "HSIC support for DIAG"

config DIAG_HSIC_PIPE
	depends on USB_QCOM_DIAG_BRIDGE
	default y
	bool "Enable 9K DIAG traffic over HSIC"
	help
	 HSIC Transport Layer for DIAG Router
endmenu

menu "LGE DM APP Support"

config LGE_DM_APP
	bool "LGE DM APP Support"
	default n
	depends on MACH_LGE
	help
	 LGE DM APP Support
endmenu

menu "USB Diag Disable"

config LGE_USB_DIAG_DISABLE
	default n
	bool "Disable diag function"
	help
	 Provide method of diag enable or disable
endmenu

menu "USB MDM Diag Disable"

config LGE_USB_MDM_DIAG_DISABLE
	default n
	bool "MDM diag disable"
	help
	 MDM diag disable
endmenu

menu "LGE DIAG MTS Daemon Support"

config LGE_MTS
	bool "LGE Diag MTS Daemon Support"
	default n
	depends on MACH_LGE
	help
	 LGE DIAG MTS Support
endmenu

menu "LGE DIAG table update twice"

config LGE_DIAG_TABLE_UPDATE_TWICE
	bool "LGE DIAG table update twice"
	default n
	depends on MACH_LGE
	help
	 LGE DIAG table twice
endmenu
```

## drivers/mosquitou/Kconfig
```kconfig
#platform.team@lge.com	2011.01

comment "LGE factory util selection"

config LGE_FELICA
	bool "felica factory util"
	default n
	---help---
	LGE fcutil related change	
```

## drivers/net/wireless/bcmdhd/Kconfig
```kconfig
config BCMDHD
	tristate "Broadcom 4330/34 wireless cards support"
	depends on MMC
	---help---
	  This module adds support for wireless adapters based on
	  Broadcom 4330/34 chipset.

	  This driver uses the kernel's wireless extensions subsystem.

	  If you choose to build a module, it'll be called dhd. Say M if
	  unsure.

config BCMDHD_FW_PATH
	depends on BCMDHD
	string "Firmware path"
	default "/system/firmware/fw_bcmdhd.bin"
	---help---
	  Path to the firmware file.
		
config BCMDHD_NVRAM_PATH
	depends on BCMDHD
	string "NVRAM path"
	default "/system/etc/wifi/bcmdhd.cal"
	---help---
	  Path to the calibration file.

config BCMDHD_WEXT
	bool "Enable WEXT support"
	depends on BCMDHD && CFG80211 = n
	select WIRELESS_EXT
	select WEXT_PRIV
	---help---
	  Enables WEXT support

config LGE_BCM433X_PATCH
	bool "BCM433X Patch by LGE"
	default y
	depends on BCMDHD

config BCMDHD_CONFIG_PATH
	string "Config path"
	default "/data/misc/wifi/config"
	---help---
	  Path to the config file.
		
config BCMDHD_GPIO_WL_RESET
	depends on BCMDHD
	int "GPIO to the Reset"
	default 82
	---help---
	  GPIO to the Reset

config BCMDHD_HOSTWAKEUP_USE_GPIO
	depends on BCMDHD
	bool "Use GPIO to Host Wakeup"
	select BCMDHD_HW_OOB
	---help---
	  Use GPIO to Host Wakeup

config BCMDHD_HOSTWAKEUP_USE_SDIO
	depends on BCMDHD && BCMDHD_HOSTWAKEUP_USE_GPIO = n
	bool "Use SDIO pin to the Host Wakeup"
	---help---
	  Use SDIO pin to the Host Wakeup

config BCMDHD_GPIO_WL_HOSTWAKEUP
	depends on BCMDHD && BCMDHD_HOSTWAKEUP_USE_GPIO = y
	int "GPIO to the Host Wakeup"
	default 81
	---help---
	  GPIO to the Host Wakeup

config BCMDHD_HW_OOB
	depends on BCMDHD
	bool "Use H/W OOB to the Host Wakeup"
	default n
	---help---
	  Use H/W OOB to the Host Wakeup

config BCMDHD_USE_STATIC_BUF
	depends on BCMDHD
	bool "Use static buffer in os_malloc"
	default n
	---help---
	  Use static buffer in os_malloc
```

## drivers/net/wireless/lge/Kconfig
```kconfig
config LGE_WLAN_FIRST_SCAN_2P4GHZ_ONLY
        bool "Enable first scan with 2.4GHz"
        ---help---
                Scan with only 2.4GHz if the scanning is first attempt after enabling wlan
```

## drivers/video/mhl/Kconfig
```kconfig
config SII8334_MHL_TX
	bool "MHL sii8334 chip support"
	depends on FB_MSM_HDMI_COMMON
	default y
	---help---
	  Support for MHL sii8334 chip

config LG_MAGIC_MOTION_REMOCON
	bool "Magic motion remocon support"
	depends on SII8334_MHL_TX
	default n
	---help---
	  Support for LG Magic motion
```

## kcj/Kconfig
```kconfig
config KYOCERA_ORIGINAL_FEATURE
	bool "KYOCERA_ORIGINAL_FEATURE"

config TARGET_PROTOTYPE_WS0
    bool "TARGET_PROTOTYPE_WS0"

config TARGET_PROTOTYPE_WS1
    bool "TARGET_PROTOTYPE_WS1"

config TARGET_PROTOTYPE_WS2
    bool "TARGET_PROTOTYPE_WS2"

config TARGET_PRODUCT_C5155
    bool "TARGET_PRODUCT_C5155"

config TARGET_PRODUCT_C5170
    bool "TARGET_PRODUCT_C5170"
```
